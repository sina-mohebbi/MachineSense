## firmware/sdkconfig.defaults
```kconfig
# TFLite-Micro's interpreter setup + the tensor arena live on the main task stack;
# the IDF default (3.5 KB) is too small and will overflow silently. Bump it.
CONFIG_ESP_MAIN_TASK_STACK_SIZE=16384

# The autoencoder is small (~640-dim dense layers), but leave headroom for the
# TFLM interpreter's own bookkeeping allocations.
CONFIG_ESP32_DEFAULT_CPU_FREQ_240=y
```
